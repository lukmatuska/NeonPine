// NeonPine animations – fixed-point port of frame(m, t) from the NeonPine simulator artifact.
//
// The CH32V003 has no FPU and no multiplier: everything is Q12 integer math with lookup tables
// (anim_tables.h, generated by ../tools/gen_anim_tables.py). One frame costs 20 electrode evaluations
// per contributing mode (up to 4 during crossfades). anim_step() does one electrode per main-loop pass
// (<= ~40 us), so the boost loop and the lamp PWM keep running between them.
//
// Time-scaled noise / phases use accumulators advanced every ms (anim_tick_ms) instead of t * rate,
// which would need 64-bit math: Q16 lattice units for the value noise (wrap continuously at 2^16),
// Q24 turns for the sine phases (wrap continuously at 2^32). Twinkle, garland and heartbeat run on
// their own ms clocks (1/64 ms), so every mode's speed can be scaled (anim_pars, set by the companion app).
//
// Besides the simulator modes: ANIM_LIVE plays frames streamed over USB, and ANIM_CUSTOM0.. play the
// keyframe animations from the store (written by the companion app). Custom blob at BLOB_ADDR:
//   0  u16 magic 0x4E41      2  u16 length (incl. header)      4  u16 sum of bytes 6 .. length-1
//   6  u8  count (<= 8)      7  u8  0
//   8  per animation: u8 keys (>= 1), u8 flags (0), u32 duration ms (= sum of the keys), char name[12],
//      then per key: u16 duration ms (bits 0-13) | transition to the next key (bits 14-15: 0 hold,
//      1 linear, 2 smooth), u8 level[10] (LA1-10: low nibble left electrode, high nibble right, 0-15)
// The animation loops; the last key fades into the first.

#include "anim.h"
#include "anim_tables.h"

#define Q 4096

// Tier of each lamp: LA1 star, LA2-3, LA4-6, LA7-10 (simulator ROW)
static const uint8_t ROW[10] = { 0, 1, 1, 2, 2, 2, 3, 3, 3, 3 };
// Garland order LA7 LA8 LA9 LA10 LA6 LA5 LA4 LA2 LA3 LA1 (simulator seq) -> rank of each lamp
static const uint8_t GARLAND_RANK[10] = { 9, 7, 8, 6, 5, 4, 0, 1, 2, 3 };

// Accumulators, advanced every ms by inc[] = base rate * the mode's speed:
//   0-2 candle e1 fbm octaves 2.6 / 5.98 / 13.26 units/s, 3-5 e2 2.4 / 5.52 / 12.24 (Q16)
//   6 candle dips 0.7 units/s (Q16), 7 breathe 1 / 5.5 s, 8 drift 1 / 13 s, 9 snow 0.42 turns/s (Q24)
#define CL_C1    0
#define CL_C2    3
#define CL_DIP   6
#define CL_BRE   7
#define CL_D13   8
#define CL_SNOW  9
#define CLOCKS   10
static const uint16_t base_inc[CLOCKS] = { 170, 392, 869, 157, 362, 802, 46, 3050, 1291, 7047 };
static const uint8_t inc_mode[CLOCKS] = { 0, 0, 0, 0, 0, 0, 0, ANIM_BREATHE, ANIM_BREATHE, ANIM_SNOWFALL };
static uint16_t inc[CLOCKS];

struct clocks {
	uint32_t ms;
	uint32_t a[CLOCKS];
	uint32_t tw, ga, hb;    // twinkle / garland / heartbeat time, 1/64 ms
};
// One set of running clocks. A frame's 20 electrodes are computed over ~1 ms of main-loop passes, so they
// see the clocks a few ms apart at most - invisible, and it saves the RAM of a snapshot (the stack needs it).
static struct clocks live;
#define fc live

int16_t anim_e1[10], anim_e2[10];
int32_t anim_rail = Q;
static int16_t acc1[10], acc2[10];

struct anim_par anim_pars[ANIM_BASIC] = { { 64, 128, 0 }, { 64, 128, 0 }, { 64, 128, 0 }, { 64, 128, 0 }, { 64, 128, 0 }, { 64, 128, 0 } };
uint8_t anim_live[21];
uint32_t anim_cur_t0, anim_prev_t0;
uint16_t anim_drift_s = 180;
uint16_t anim_drift_mask = 0x3f;
uint8_t anim_fade_ds = 15;

// Modes contributing to this frame, weights Q12. Custom animations: the two keys around the frame time
// (offsets from BLOB_ADDR) and how far between them (f, Q12, already shaped by the transition).
static struct { uint16_t ka, kb; int16_t w, f; uint8_t m; } ent[4];
static uint8_t n_ent, ent_j, ent_r, busy, n_custom;

void anim_params_changed( void )
{
	for( int k = 0; k < CLOCKS; k++ ) inc[k] = base_inc[k] * anim_pars[inc_mode[k]].speed >> 6;
}

void anim_tick_ms( void )
{
	live.ms++;
	for( int k = 0; k < CLOCKS; k++ ) live.a[k] += inc[k];
	live.tw += anim_pars[ANIM_TWINKLE].speed;
	live.ga += anim_pars[ANIM_GARLAND].speed;
	live.hb += anim_pars[ANIM_HEARTBEAT].speed;
}

// ---- math ----------------------------------------------------------------------------------------

static int32_t clampq( int32_t x, int32_t lo, int32_t hi )
{
	return x < lo ? lo : x > hi ? hi : x;
}

int32_t anim_smooth( int32_t x )
{
	x = clampq( x, 0, Q );
	return ( x * x >> 12 ) * ( 3 * Q - 2 * x ) >> 12;
}

static int32_t sin_at( uint32_t i )  // sin(2 pi i / 256), quarter-wave table
{
	uint32_t q = i & 127;
	int32_t v = sin_tab[q > 64 ? 128 - q : q];
	return i & 128 ? -v : v;
}

static int32_t sinq( uint32_t ph )  // ph: 65536 = one turn
{
	ph &= 0xffff;
	int32_t i = ph >> 8, f = ph & 255, a = sin_at( i ), b = sin_at( i + 1 );
	return a + ( ( b - a ) * f >> 8 );
}

static int32_t expneg( int32_t x )  // e^-x, x in Q12 >= 0
{
	if( x <= 0 ) return Q;
	if( x >= 8 * Q ) return 0;
	int32_t i = x >> 8, f = x & 255, a = expneg_tab[i], b = expneg_tab[i + 1];
	return a + ( ( b - a ) * f >> 8 );
}

static int32_t hashq( uint32_t seed, uint32_t i )  // pseudo-random 0..4080 per (seed, lattice point)
{
	return perm_tab[( perm_tab[( i ^ ( i >> 8 ) ) & 255] + seed ) & 255] << 4;
}

static int32_t vnoise( uint32_t seed, uint32_t x )  // value noise, x in Q16 lattice units
{
	uint32_t i = x >> 16;
	int32_t a = hashq( seed, i ), b = hashq( seed, ( i + 1 ) & 0xffff );
	return a + ( ( b - a ) * anim_smooth( ( x >> 4 ) & 0xfff ) >> 12 );
}

// ---- modes (simulator frame(m, t), per electrode) -------------------------------------------------

static int32_t candle( int i, int side )
{
	// clamp(0.28 + 0.4 * fbm(seed, t * rate) - dip, 0.08, 0.6); dip = 0.3 while vnoise(s + 40, 0.7 t) > 0.93
	uint32_t seed = side ? i + 101 : i + 1;
	const uint32_t * c = fc.a + ( side ? CL_C2 : CL_C1 );
	int32_t f = ( vnoise( seed, c[0] ) * 2253 + vnoise( seed + 11, c[1] ) * 1147 + vnoise( seed + 23, c[2] ) * 696 ) >> 12;
	int32_t dip = vnoise( side ? i + 90 : i + 40, fc.a[CL_DIP] ) > 3809 ? 1229 : 0;
	return clampq( 1147 + ( 1638 * f >> 12 ) - dip, 328, 2458 );
}

static int32_t breathe( int i, int side )
{
	// s = 0.5 + 0.5 sin(2 pi (t / 13 - ROW * 0.08)); e1 = s, e2 = 1 - s
	int32_t s = 2048 + ( sinq( ( fc.a[CL_D13] >> 8 ) - ROW[i] * 5243u ) >> 1 );
	return side ? Q - s : s;
}

static int32_t breathe_rail( void )
{
	// 0.08 + 0.92 * (0.5 - 0.5 cos(2 pi t / 5.5))
	return 328 + ( 3768 * ( 2048 - ( sinq( ( fc.a[CL_BRE] >> 8 ) + 16384 ) >> 1 ) ) >> 12 );
}

static int32_t twinkle( int i, int side )
{
	// period P = 2.2 .. 5.4 s, random phase; 0.35 s swell (smoothstep), then exp decay (0.55 s)
	uint32_t j = side * 10 + i;
	uint32_t p = 2200 + ( hashq( 31, j ) * 3200 >> 12 );
	uint32_t ph = ( ( fc.tw >> 6 ) + ( hashq( 57, j ) * p >> 12 ) ) % p;
	int32_t e = ph < 350 ? anim_smooth( ph * Q / 350 ) : expneg( ( ph - 350 ) * Q / 550 );
	return 246 + ( 3441 * e >> 12 );
}

static int32_t garland( int i, int side )
{
	// 5.2 s cycle: 3.4 s chase over 20 electrode steps, then the star holds and the rest decays
	uint32_t c = ( fc.ga >> 6 ) % 5200;
	int32_t k = GARLAND_RANK[i];
	if( c <= 3400 )
	{
		int32_t pos = c * 81920u / 3400;  // Q12, 0..20
		if( !side ) return 205 + ( 2253 * clampq( pos - 2 * k * Q, 0, Q ) >> 12 );
		return 205 + ( 1638 * clampq( pos - ( 2 * k + 1 ) * Q, 0, Q ) >> 12 );
	}
	uint32_t ft = c - 3400;
	if( ft < 180 || i == 0 ) return 2048;  // flash of the whole tree, then the star stays at 0.5
	return 205 + ( 1843 * expneg( ft * 9011 / 1000 ) >> 12 );
}

static int32_t snowfall( int i, int side )
{
	// 0.05 + 0.7 * max(0, sin(2 pi ph))^6, ph = 0.42 t - ROW * 0.22 (+ per-electrode offsets)
	uint32_t ph = ( fc.a[CL_SNOW] >> 8 ) - ROW[i] * 14418u;
	ph += side ? 19661 + ( hashq( 89, i ) * 7864 >> 12 ) : ( hashq( 51, i ) * 3932 >> 12 );
	int32_t s = sinq( ph );
	if( s < 0 ) s = 0;
	int32_t s2 = s * s >> 12, s6 = ( s2 * s2 >> 12 ) * s2 >> 12;
	return 205 + ( 2867 * s6 >> 12 );
}

static int32_t heartbeat( int i, int side )
{
	// tree at 0.28; star e1 beats at 0.05 s, e2 at 0.28 s of every second (Gaussian pulses)
	if( i ) return 1147;
	int32_t c = ( fc.hb >> 6 ) % 1000, mu = side ? 280 : 50, w = side ? 60 : 50;
	int32_t d = ( c - mu ) * Q / w;
	int32_t u = ( d > 3 * Q || d < -3 * Q ) ? 8 * Q : d * d >> 12;
	return clampq( 614 + ( 3482 * expneg( u ) >> 12 ), 0, Q );
}

static int32_t electrode( int m, int i, int side )
{
	switch( m )
	{
	case ANIM_BREATHE:   return breathe( i, side );
	case ANIM_TWINKLE:   return twinkle( i, side );
	case ANIM_GARLAND:   return garland( i, side );
	case ANIM_SNOWFALL:  return snowfall( i, side );
	case ANIM_HEARTBEAT: return heartbeat( i, side );
	default:             return candle( i, side );
	}
}

// ---- custom keyframe animations ------------------------------------------------------------------

#define BLOB_MAGIC 0x4e41
#define AHDR       18  // animation header
#define KEY        12

static uint32_t rd16( const uint8_t * p ) { return p[0] | p[1] << 8; }  // the blob isn't word aligned
static uint32_t rd32( const uint8_t * p ) { return rd16( p ) | rd16( p + 2 ) << 16; }

static const uint8_t * custom_hdr( int k )
{
	const uint8_t * p = (const uint8_t *)BLOB_ADDR + 8;
	while( k-- ) p += AHDR + p[0] * KEY;
	return p;
}

void anim_store_changed( void )
{
	const uint8_t * b = (const uint8_t *)BLOB_ADDR;
	uint32_t len = rd16( b + 2 ), sum = 0;
	n_custom = 0;
	if( rd16( b ) != BLOB_MAGIC || len < 8 || len > BLOB_MAX || b[6] > ANIM_CUSTOMS ) return;
	for( uint32_t i = 6; i < len; i++ ) sum += b[i];
	if( ( sum & 0xffff ) != rd16( b + 4 ) ) return;
	const uint8_t * p = b + 8, * end = b + len;
	for( int k = 0; k < b[6]; k++ )
	{
		if( p + AHDR > end || !p[0] ) return;
		const uint8_t * key = p + AHDR, * kend = key + p[0] * KEY;
		uint32_t t = 0;
		if( kend > end ) return;
		for( ; key < kend; key += KEY ) t += rd16( key ) & 0x3fff;
		if( !t || t != rd32( p + 2 ) ) return;
		p = kend;
	}
	n_custom = b[6];
}

int anim_custom_count( void )
{
	return n_custom;
}

// Entry j plays custom animation k, t ms after it started.
static void plan_custom( int j, int k, int32_t t )
{
	const uint8_t * h = custom_hdr( k ), * key = h + AHDR;
	uint32_t n = h[0], i = 0, d;
	if( t < 0 ) t = 0;  // fading in ahead of its start (drift): hold the first key
	t %= rd32( h + 2 );
	while( ( d = rd16( key ) & 0x3fff ) <= (uint32_t)t && i + 1 < n ) { t -= d; key += KEY; i++; }
	ent[j].ka = key - (const uint8_t *)BLOB_ADDR;
	ent[j].kb = ( i + 1 < n ? key + KEY : h + AHDR ) - (const uint8_t *)BLOB_ADDR;
	int tr = rd16( key ) >> 14;
	int32_t f = !tr || !d ? 0 : clampq( t * Q / d, 0, Q );
	ent[j].f = tr == 2 ? anim_smooth( f ) : f;
}

static int32_t custom_el( int j, int i, int side )
{
	const uint8_t * blob = (const uint8_t *)BLOB_ADDR + 2 + i;
	int a = blob[ent[j].ka], b = blob[ent[j].kb];
	if( side ) { a >>= 4; b >>= 4; }
	else { a &= 15; b &= 15; }
	return a * 273 + ( ( b - a ) * 273 * ent[j].f >> 12 );  // 15 -> 4095
}

// ---- frame plan ----------------------------------------------------------------------------------

static int drift_ok( int k )  // drift list bit k: modes 0-5, custom 0-7 at bits 8-15
{
	return ( anim_drift_mask >> k & 1 ) && ( k < ANIM_BASIC || ( k >= 8 && k - 8 < n_custom ) );
}

static void add_entry( int m, int32_t w, uint32_t t0 )
{
	if( w <= 0 ) return;
	if( m == ANIM_SLEEP || ( m >= ANIMS && m != ANIM_LIVE && m - ANIM_CUSTOM0 >= n_custom ) ) m = ANIM_CANDLE;
	if( m == ANIM_DRIFT )
	{
		// the drift list in order, anim_drift_s each, crossfading over the last anim_fade_ds
		uint8_t ids[14];
		int n = 0;
		for( int k = 0; k < 16; k++ )
			if( drift_ok( k ) ) ids[n++] = k < 8 ? k : ANIM_CUSTOM0 + k - 8;
		if( !n ) { add_entry( ANIM_CANDLE, w, t0 ); return; }
		uint32_t d = anim_drift_s * 1000u, step = fc.ms / d, in = fc.ms - step * d, pos = step % n;
		int32_t fade = anim_fade_ds ? anim_fade_ds * 100 : 1, x = (int32_t)( in + fade - d );
		int32_t f = x <= 0 ? 0 : anim_smooth( x * Q / fade );
		add_entry( ids[pos], w * ( Q - f ) >> 12, fc.ms - in );
		add_entry( ids[pos + 1 < (uint32_t)n ? pos + 1 : 0], w * f >> 12, fc.ms - in + d );
		return;
	}
	for( int j = 0; j < n_ent; j++ )
		if( ent[j].m == m ) { ent[j].w += w; return; }
	if( n_ent < 4 )
	{
		ent[n_ent].m = m;
		ent[n_ent].w = w;
		if( m >= ANIM_CUSTOM0 ) plan_custom( n_ent, m - ANIM_CUSTOM0, fc.ms - t0 );
		n_ent++;
	}
}

void anim_start( int cur, int prev, int32_t k )
{
	n_ent = 0;
	k = clampq( k, 0, Q );
	add_entry( prev, Q - k, anim_prev_t0 );
	add_entry( cur, k, anim_cur_t0 );
	for( int i = 0; i < 10; i++ ) acc1[i] = acc2[i] = 0;
	ent_j = ent_r = 0;
	busy = n_ent > 0;
}

int anim_busy( void )
{
	return busy;
}

int anim_step( void )
{
	if( !busy ) return 0;
	int lamp = ent_r >> 1, side = ent_r & 1, m = ent[ent_j].m;
	int32_t v;
	if( m >= ANIM_CUSTOM0 ) v = custom_el( ent_j, lamp, side );
	else if( m == ANIM_LIVE ) { v = anim_live[1 + side * 10 + lamp]; v = v * 16 + ( v >> 4 ); }
	else
	{
		const struct anim_par * p = &anim_pars[m];
		v = clampq( ( electrode( m, lamp, side ) * p->gain >> 7 ) + p->offset * 16, 0, Q );
	}
	v = v * ent[ent_j].w >> 12;
	if( side ) acc2[lamp] += v;
	else acc1[lamp] += v;
	if( ++ent_r < 20 ) return 0;
	ent_r = 0;
	if( ++ent_j < n_ent ) return 0;

	// Frame complete: publish it.
	int32_t rail = 0;
	for( int j = 0; j < n_ent; j++ )
		rail += ( ent[j].m == ANIM_BREATHE ? breathe_rail() : Q ) * ent[j].w >> 12;
	anim_rail = clampq( rail, 0, Q );
	for( int i = 0; i < 10; i++ ) { anim_e1[i] = acc1[i]; anim_e2[i] = acc2[i]; }
	busy = 0;
	return 1;
}
